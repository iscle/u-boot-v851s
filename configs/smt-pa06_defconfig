## configs/smt-pa06_defconfig
```kconfig
CONFIG_ARM=y
CONFIG_ARCH_SUNXI=y
CONFIG_DEFAULT_DEVICE_TREE="sun8i-v851s-smt-pa06"
CONFIG_SPL=y
CONFIG_MACH_SUN8I_V851S=y
CONFIG_SUNXI_DRAM_TYPE_DDR2=y
CONFIG_DRAM_CLK=528
CONFIG_DRAM_ZQ=8092665
CONFIG_SUNXI_MINIMUM_DRAM_MB=64
# CONFIG_SYS_MALLOC_CLEAR_ON_INIT is not set
CONFIG_DRAM_SUNXI_ODT_EN=0
CONFIG_DRAM_SUNXI_PARA1=0x00d2
CONFIG_DRAM_SUNXI_MR1=0x02
CONFIG_DRAM_SUNXI_TPR11=0x00000022
CONFIG_DRAM_SUNXI_TPR12=0x00000077
CONFIG_DRAM_SUNXI_TPR13=0x34000100
CONFIG_CONS_INDEX=1
CONFIG_SPL_SPI_SUNXI=y
CONFIG_CONSOLE_MUX=y
CONFIG_MTD=y
CONFIG_SPI_FLASH_WINBOND=y
CONFIG_SPI=y
```
